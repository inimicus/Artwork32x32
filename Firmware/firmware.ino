/*
* Modified by Markus Lipp adding interleaved buffers, streaming, 32x32 & 24bit support
* Based on "_16x32_Matrix R3.0" by Creater Alex Medeiros, http://PenguinTech.tk
* Use code freely and distort its contents as much as you want, just remeber to thank the 
* original creaters of the code by leaving their information in the header. :)
*/


//PortC[0:11] = {15, 22, 23, 9, 10, 13, 11, 12, 28, 27, 29, 30}
//PortD[0:7] = {2, 14, 7, 8, 6, 20, 21, 5}
//Define pins
const uint8_t
//PortC
APIN      = 15, BPIN      = 22, CPIN      = 23, DPIN = 9,
CLOCKPIN  = 10, LATCHPIN  = 13, OEPIN     = 11,
//PortD
R1PIN     = 2, R2PIN     = 8,
G1PIN     = 14, G2PIN     = 6,
B1PIN     = 7, B2PIN     = 20;

uint8_t pinTable[13] = {
  R1PIN,R2PIN,G1PIN,G2PIN,B1PIN,B2PIN,
  APIN,BPIN,CPIN,DPIN,CLOCKPIN,LATCHPIN,OEPIN};

//Addresses 1/8 rows Through a decoder
uint16_t const A = 1, B = 2,C = 4, D=8;
//Acts like a 16 bit shift register
uint16_t const SCLK   = 16;
uint16_t const LATCH  = 32;
uint16_t const OE     = 64;

byte buffer[64];
uint8_t packetsTotal    = 64,
        packetsCount    = 0;

uint16_t const abcVar[16] = { //Decoder counter var
  0,A,B,A+B,C,C+A,C+B,A+B+C,
  0+D,A+D,B+D,A+B+D,C+D,C+A+D,C+B+D,A+B+C+D};

//Data Lines for row 1 red and row 9 red, ect.
uint16_t const RED1   = 1, RED2   = 8;
uint16_t const GREEN1 = 2, GREEN2 = 16;
uint16_t const BLUE1  = 4, BLUE2  = 32;

const uint8_t SIZEX = 32;
const uint8_t SIZEY = 32;



//BAM and interrupt variables
uint8_t     rowN    = 0;
uint16_t    BAM;
uint8_t     BAMMAX  = 7; //now 24bit color! (0-7)


void setup() {
  for(uint8_t i = 0; i < 13; i++){
        pinMode(pinTable[i], OUTPUT);
    }
  timerInit();
  Serial.begin(250000); 
}

uint8_t r,g, prevVal,val;
int dataPos=0;


byte interleavedBuffer[] = {0,16,8,26,18,58,18,62,24,16,32,0,8,20,28,32,16,8,24,38,56,44,44,16,8,48,8,20,16,16,8,24,
    9,9,25,63,55,55,63,51,9,41,53,33,33,1,57,25,9,17,17,27,49,61,57,17,17,1,57,41,17,33,9,49,
    0,16,16,10,2,42,42,10,48,16,24,16,8,40,40,8,32,8,36,26,16,24,24,40,16,40,16,48,32,16,32,32,
    62,22,22,60,20,4,12,4,30,6,6,6,30,54,6,14,30,14,22,4,14,6,6,22,46,30,22,14,54,14,38,62,
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    4,4,4,4,4,7,0,0,0,0,0,0,0,0,0,0,0,0,0,0,0,0,0,0,0,0,4,4,4,4,4,4};

byte tempInterleavedBuffer[4096];

//byte interleavedBuffer[4096];

void loop() {       

    int n;
    n = RawHID.recv(buffer, 0); // 0 timeout = do not wait
    if (n > 0) {

        if(strcmp("START", (const char*)buffer) == 0) {

            //packetsCount = buffer[3];

//            Serial.print("Received packet #");
//            Serial.println(packetsCount);


            Serial.println((const char*)buffer);
            packetsCount = 0;

        } else if (strcmp("STOP", (const char*)buffer) == 0) {

            Serial.println((const char*)buffer);
            packetsCount = 0;

            memcpy(interleavedBuffer, tempInterleavedBuffer, 4096);

//            for(uint16_t i = 0; i < 4096; i++) {
//                Serial.print(interleavedBuffer[i]);
//                Serial.print(",");
//            }

        } else {

            // Reconstruct data
            for (int i = 0; i < 64; i++) {
                uint16_t progress = (packetsCount * 64)+i;
                tempInterleavedBuffer[progress] = buffer[i];

                Serial.print("Writing: ");
                Serial.println(progress);
            }

            //Serial.println(packetsCount);
            packetsCount++;

        }

//        Serial.print("First byte: ");
//        Serial.println((int)buffer[0]);

//        packetsCount++;
//
//        if (packetsCount > packetsTotal) {
//            packetsCount = 0;
//        }

    }

}

IntervalTimer timer1;

void timerInit() {
    BAM = 0;
    attackMatrix();
}


//The updating matrix stuff happens here
//each pair of rows is taken through its BAM cycle
//then the rowNumber is increased and id done again
void attackMatrix() {
    timer1.end();    
    
    uint16_t portData;
    portData = 0; // Clear data to enter
    portData |= (abcVar[rowN]);//|OE; // abc, OE
    portData &=~ LATCH;        //LATCH LOW
    GPIOC_PDOR = portData;  // Write to Port
    
    uint8_t *start = &interleavedBuffer[rowN*SIZEX*8+BAM*32];    
    for(uint8_t _x = 0; _x < 32; _x++){
          GPIOD_PDOR = start[_x]; // Transfer data
          GPIOC_PDOR |=  SCLK;// Clock HIGH
          GPIOC_PDOR &=~ SCLK;// Clock LOW
    }

    GPIOC_PDOR |= LATCH;// Latch HIGH
    GPIOC_PDOR &=~ OE;// OE LOW, Displays line

    #define LOOPTIME 2 //trial&error to get both smooth gradients & little flicker
    #define CALLOVERHEAD 1
    timer1.begin(attackMatrix,((LOOPTIME+CALLOVERHEAD)<<BAM)-CALLOVERHEAD);
  
    if(BAM >= BAMMAX) { //Checks the BAM cycle for next time.    
        if(rowN == 15){
            rowN = 0;
        } else {
            rowN ++;
        }        
        BAM = 0;
      } else {
        BAM ++;
    }
}
